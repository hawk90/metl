## zephyr/Kconfig
```kconfig
# Kconfig for the metl Zephyr module.
#
# metl is header-only, so there is nothing to compile into the RTOS; this
# symbol just gates whether metl's include/ directory is added to the Zephyr
# build (see zephyr/CMakeLists.txt). Applications opt in with `CONFIG_METL=y`.

config METL
	bool "metl (Modern Embedded Template Library) headers"
	help
	  Expose the header-only metl C++17 library to the application by
	  adding its public include/ directory to the Zephyr build's include
	  path. metl requires C++17 (CONFIG_STD_CPP17=y) and does not use
	  exceptions or RTTI. No sources are compiled into the image — enabling
	  this only makes <metl/...> headers includable.
```
