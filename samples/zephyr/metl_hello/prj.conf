## CMakeLists.txt
```
# Zephyr sample application that consumes metl as a module.
#
# Standard Zephyr application boilerplate: locate the Zephyr build system, then
# declare the app. metl's headers are made available by the metl Zephyr module
# (see <metl-root>/zephyr/) when CONFIG_METL=y (set in prj.conf) and the module
# is on Zephyr's module path (EXTRA_ZEPHYR_MODULES=<metl-root>).

cmake_minimum_required(VERSION 3.20.0)

find_package(Zephyr REQUIRED HINTS $ENV{ZEPHYR_BASE})
project(metl_hello LANGUAGES C CXX)

target_sources(app PRIVATE src/main.cpp)
```

## sample.yaml
```
# Twister metadata for the metl-on-Zephyr sample.
#
# `west twister` uses this to build AND run the sample on the listed platforms,
# monitoring the console for the sentinel the app prints. The console harness
# makes the QEMU run self-terminating and turns "sentinel seen" into pass/fail,
# which is the robust way to assert execution success on an emulated target
# (no manual `west build -t run` timeout handling needed).
sample:
  name: metl hello
  description: Consume the header-only metl C++17 library as a Zephyr module.
common:
  tags: metl cpp
  # Match the single deterministic line main() prints on success.
  harness: console
  harness_config:
    type: one_line
    regex:
      - "metl on Zephyr: OK"
tests:
  sample.metl.hello:
    # qemu_cortex_m3 is runnable under QEMU; native_sim runs as a host process.
    # Both are exercised by CI. Add more boards as needed.
    platform_allow:
      - qemu_cortex_m3
      - native_sim
    integration_platforms:
      - qemu_cortex_m3
```

## prj.conf
```kconfig
# Application configuration for the metl Zephyr sample.

# --- C++ ---------------------------------------------------------------------
# metl is a C++17 library. Enable the C++ subsystem and select C++17.
CONFIG_CPP=y
CONFIG_STD_CPP17=y

# metl is exception-free and RTTI-free by design; keep both OFF (Zephyr default)
# so the sample builds with the same "no exceptions / no RTTI" contract metl is
# validated under elsewhere in CI.
CONFIG_CPP_EXCEPTIONS=n
CONFIG_CPP_RTTI=n

# --- metl module -------------------------------------------------------------
# Adds metl's include/ directory to the build (see <metl-root>/zephyr/Kconfig).
CONFIG_METL=y

# --- C++ standard library ----------------------------------------------------
# metl only pulls freestanding-style standard headers here (<type_traits>,
# <utility>, <new>, <iterator>, <initializer_list>, <cstddef>). Those
# libstdc++ headers are template-only, but on Zephyr the safest, most portable
# choice is the full C++ library (which also selects a fuller C library,
# e.g. picolibc). This is the low-risk default for correct-by-construction CI.
#
# ITERATION NOTE: metl is freestanding-friendly, so the minimal libc *may*
# suffice for this sample (fixed_vector / expected / span do not include
# <functional> or allocate). If you want the smallest footprint, try dropping
# the next line (and optionally `CONFIG_MINIMAL_LIBC=y`) and rebuild; escalate
# back to full libc++ only if the standard headers fail to compile/link.
CONFIG_REQUIRES_FULL_LIBCPP=y

# Deterministic, quiet console for the sample's single sentinel line.
CONFIG_PRINTK=y
```

## src/main.cpp
```c
/*
 * metl-on-Zephyr sample.
 *
 * Exercises a couple of metl types (fixed_vector + expected + span) on a real
 * Zephyr target to prove the module wiring works: the app compiles as C++17,
 * finds <metl/...> via the metl Zephyr module, and links against Zephyr's C++
 * runtime with no exceptions / no RTTI / no heap.
 *
 * Deterministic by construction: fixed inputs, fixed-capacity storage, and a
 * single sentinel line ("metl on Zephyr: OK ...") that CI (twister console
 * harness) greps for. Returns 0 on success.
 */

#include <metl/expected.hpp>
#include <metl/fixed_vector.hpp>
#include <metl/span.hpp>
#include <zephyr/kernel.h>

namespace {

// Exception-free error handling with metl::expected: divide, or report an
// error value instead of throwing.
metl::expected<int, int> checked_div(int numerator, int denominator) {
  if (denominator == 0) {
    return metl::unexpected<int>{-1};
  }
  return numerator / denominator;
}

// Sum a view without owning it (metl::span is a non-owning contiguous view).
int sum(metl::span<const int> xs) {
  int total = 0;
  for (int x : xs) {
    total += x;
  }
  return total;
}

}  // namespace

int main(void) {
  // Fixed-capacity, no-heap container.
  metl::fixed_vector<int, 8> v;
  v.push_back(2);
  v.push_back(3);
  v.push_back(4);

  const int total = sum(metl::span<const int>{v.data(), v.size()});  // 9
  const auto avg = checked_div(total, static_cast<int>(v.size()));   // 9 / 3 = 3
  const auto bad = checked_div(total, 0);                            // error path

  const bool ok = (total == 9) && avg.has_value() && (avg.value() == 3) && !bad.has_value();

  if (ok) {
    printk("metl on Zephyr: OK total=%d avg=%d\n", total, avg.value());
    return 0;
  }

  printk("metl on Zephyr: FAIL total=%d\n", total);
  return 1;
}
```
